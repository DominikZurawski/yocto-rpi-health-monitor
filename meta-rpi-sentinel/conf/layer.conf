## meta-rpi-sentinel/conf/layer.conf
```bitbake
BBPATH .= ":${LAYERDIR}"
BBFILES += "${LAYERDIR}/recipes-*/*/*.bb"

BBFILE_COLLECTIONS += "rpi-sentinel"
BBFILE_PATTERN_rpi-sentinel = "^${LAYERDIR}/"
LAYERDEPENDS_rpi-sentinel = "core"
LAYERSERIES_COMPAT_rpi-sentinel = "wrynose"
```
